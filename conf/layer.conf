## conf/layer.conf
```bitbake
# We have a conf and classes directory, add to BBPATH
BBPATH .= ":${LAYERDIR}"

# We have recipes-* directories, add to BBFILES
BBFILES += "${LAYERDIR}/recipes-*/*/*.bb \
            ${LAYERDIR}/recipes-*/*/*.bbappend"

BBFILE_COLLECTIONS += "meta-low-latency"
BBFILE_PATTERN_meta-low-latency = "^${LAYERDIR}/"
BBFILE_PRIORITY_meta-low-latency = "6"

LAYERDEPENDS_meta-low-latency = "core"
LAYERSERIES_COMPAT_meta-low-latency = "scarthgap"
```

## conf/machine/nuc-low-latency.conf
```bitbake
#@TYPE: Machine
#@NAME: NUC Low Latency
#@DESCRIPTION: Machine configuration for Intel NUC with low latency optimizations

require conf/machine/intel-corei7-64.conf

PREFERRED_PROVIDER_virtual/kernel = "linux-intel-rt"

# Default isolation range, can be overridden in local.conf
ISOLCPUS_RANGE ?= "2-N"

# Kernel command line parameters for low latency
APPEND += "isolcpus=${ISOLCPUS_RANGE} nohz_full=${ISOLCPUS_RANGE} rcu_nocbs=${ISOLCPUS_RANGE} \
           intel_pstate=disable nosoftlockup irqaffinity=0,1,2,3 \
           processor.max_cstate=1 intel_idle.max_cstate=1 cpufreq.default_governor=performance"

# WIC configuration
WKS_FILE = "nuc-low-latency.wks"

# Serial console
SERIAL_CONSOLES = "115200;ttyS0"
```

## wic/nuc-low-latency.wks
```
# short-description: Create an EFI disk image with a 10G data partition
# long-description: Creates a partitioned disk image for Intel NUC with
# an EFI boot partition, a rootfs partition, and a 10G data partition.

part /boot --source bootimg-efi --sourceparams="loader=grub-efi" --ondisk sda --label msdos --active --align 1024
part / --source rootfs --ondisk sda --fstype=ext4 --label platform --align 1024 --use-uuid
part /data --ondisk sda --size 10240 --fstype=ext4 --label data --align 1024 --use-uuid
```
